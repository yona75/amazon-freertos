## demos/espressif/esp32_devkitc_esp_wrover_kit/common/application_code/espressif_code/amazon-freertos-common/Kconfig.projbuild
```kconfig
menu "Example Configuration"

config BUTTON_PIN
    int "Number of the PIN connected to the BUTTON"
	range 0 34
	default 0

config LED_PIN
    int "Number of the PIN connected to the LED"
	range 0 34
	default 5

config DELAY
    int "Delay in milliseconds"
	range 500 5000
	default 1000


endmenu
```
